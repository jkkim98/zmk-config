## config/west.yml
```yaml
manifest:
  remotes:
    - name: zmkfirmware
      url-base: https://github.com/zmkfirmware
  projects:
    - name: zmk
      remote: zmkfirmware
      revision: f31ffd8acbf1725977744e836e2602e2cc488445
      import: app/west.yml
  self:
    path: config
```
